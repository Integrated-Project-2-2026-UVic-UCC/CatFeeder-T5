// ==========================================================================
// Motor.ino — NEMA 17 via DRV8825 (STEP / DIR / ENABLE, EN active-LOW)
// ==========================================================================
// Step generation uses ESP32 hardware LEDC (PWM) so the pulse train is
// completely independent of the main-loop timing. This is equivalent to
// Test_Motor.ino's blocking delayMicroseconds() approach but non-blocking.
//
// LEDC channel 0 → STEPPER_STEP pin (GPIO 26)
// Frequency: MOTOR_STEP_HZ (625 Hz = 625 microsteps/s)
// With 16× microstepping: 625/16 = 39 full steps/s ≈ 11.7 RPM
// (Test_Motor used 500 steps/s = 9.4 RPM — same order, proven working)
//
// Gravimetric stop at 90% + 500 ms non-blocking settle.
// 2-second EMI dead zone at start of each cycle.
// 30-second hard safety timeout.
// ==========================================================================

// ESP32 core 3.x LEDC API doesn't require explicit channels
#define MOTOR_STEP_HZ       500    // microsteps per second (Matches Test_Motor: 1000us x2 = 500Hz)
#define MOTOR_LEDC_BITS     8      // 8-bit resolution (0-255)
#define MOTOR_DUTY_RUN      128    // 50% duty = square wave
#define MOTOR_DUTY_STOP     0      // 0% = no pulses

// Scale polling during dispensing
#define DISPENSE_SCALE_MS   300UL  // read scale at most once per 300 ms
static uint32_t lastScaleCheckMs = 0;

// Non-blocking settling sub-state
static bool     waitingFinalRead = false;
static uint32_t settleStartMs    = 0;

// --------------------------------------------------------------------------
void motorInit() {
  pinMode(STEPPER_EN,  OUTPUT);
  pinMode(STEPPER_DIR, OUTPUT);
  digitalWrite(STEPPER_EN,  HIGH);  // disabled (active-LOW)
  digitalWrite(STEPPER_DIR, LOW);   // DIRECCIO_NORMAL = LOW (same as Test_Motor)

  // Attach LEDC hardware PWM to the STEP pin (ESP32 Core 3.x API)
  ledcAttach(STEPPER_STEP, MOTOR_STEP_HZ, MOTOR_LEDC_BITS);
  ledcWrite(STEPPER_STEP, MOTOR_DUTY_STOP);  // not running yet

  Serial.println(F("[motor] stepper driver ready (LEDC hardware PWM)"));
}

// Direct EN control (active-LOW).
void motorEnable(bool on) {
  digitalWrite(STEPPER_EN, on ? LOW : HIGH);
}

// Immediately stop pulses and cut driver power.
void motorEmergencyStop() {
  ledcWrite(STEPPER_STEP, MOTOR_DUTY_STOP);
  motorEnable(false);
  cycle.active     = false;
  waitingFinalRead = false;
  Serial.println(F("[motor] emergency stop"));
}

// --------------------------------------------------------------------------
// Start a dispensing cycle.
// Signature: (grams, trigger, commandId, catId, scheduleId)
bool startDispense(float grams,
                   const char *trigger,
                   const String &commandId,
                   const String &catId,
                   const String &scheduleId) {
  if (currentState == STATE_DISPENSING || cycle.active) {
    Serial.println(F("[motor] rejected: already dispensing"));
    return false;
  }
  if (grams < MIN_PORTION_G || grams > MAX_PORTION_G) {
    Serial.printf("[motor] rejected: %.1f g out of range\n", grams);
    return false;
  }

  // Read baseline weight without taring so pre-existing food is preserved.

  cycle.active        = true;
  cycle.targetG       = grams;
  cycle.dispensedG    = 0.0f;
  cycle.baselineG     = scaleRead();
  Serial.printf("[motor] baseline=%.1fg\n", cycle.baselineG);
  cycle.startMs       = millis();
  cycle.lastPublishMs = 0;
  cycle.trigger       = trigger;
  cycle.commandId     = commandId;
  cycle.catId         = catId;
  cycle.scheduleId    = scheduleId;
  cycle.startedAtIso  = isoTimestamp();

  waitingFinalRead = false;
  lastScaleCheckMs = millis();

  // Set direction and enable driver BEFORE starting PWM pulses
  digitalWrite(STEPPER_DIR, LOW);   // DIRECCIO_NORMAL = LOW
  motorEnable(true);
  delay(5);  // let coils charge (same as Test_Motor)

  // Start hardware PWM — generates step pulses independently of the loop
  ledcWrite(STEPPER_STEP, MOTOR_DUTY_RUN);

  currentState = STATE_DISPENSING;
  Serial.printf("[motor] dispensing %.1fg (%s) — LEDC @%dHz, stop@%.0f%%\n",
                grams, trigger, MOTOR_STEP_HZ,
                FEED_STOP_THRESHOLD * 100.0f);
  return true;
}

// --------------------------------------------------------------------------
// Called every loop while in STATE_DISPENSING. Non-blocking.
// The STEP pulses are generated by hardware — this function only monitors
// the scale and decides when to stop.
void runDispensingCycle() {
  const uint32_t nowMs = millis();

  // ── Phase B: settling after auger stopped ────────────────────────────────
  if (waitingFinalRead) {
    if (nowMs - settleStartMs >= FEED_SETTLE_MS) {
      float raw = cycle.baselineG + cycle.dispensedG; // fallback to last known reading
      uint32_t tStart = millis();
      bool success = false;
      // Wait up to 150ms for the scale to be ready to ensure a clean final reading
      while (millis() - tStart < 150) {
        if (scale.is_ready()) {
          raw = scale.get_units(3); // 3 samples for accurate final average
          success = true;
          break;
        }
        delay(10);
      }
      float finalDispensed = raw - cycle.baselineG;
      if (finalDispensed < 0) finalDispensed = 0.0f;
      if (success) {
        telemetry.weightG = raw; // update telemetry with final absolute weight
      }
      waitingFinalRead = false;
      cycleFinish("completed", finalDispensed);
    }
    return;
  }

  // ── Phase A: motor running — monitor scale ────────────────────────────────

  // Rate-limited scale read (1 sample only when HX711 is ready)
  if (nowMs - lastScaleCheckMs >= DISPENSE_SCALE_MS && scale.is_ready()) {
    lastScaleCheckMs = nowMs;
    float raw  = scale.get_units(1);
    float disp = raw - cycle.baselineG;
    if (disp < 0) disp = 0;
    cycle.dispensedG = disp;
    telemetry.weightG = raw; // Update telemetry weight in real-time with absolute weight
  }

  // 2-second dead zone: ignore scale spikes from motor EMI at startup
  const bool scaleReliable = (nowMs - cycle.startMs) >= 2000UL;

  // Gravimetric stop at 90% of target
  if (scaleReliable && cycle.dispensedG >= cycle.targetG * FEED_STOP_THRESHOLD) {
    ledcWrite(STEPPER_STEP, MOTOR_DUTY_STOP);  // stop PWM
    motorEnable(false);
    waitingFinalRead = true;
    settleStartMs    = nowMs;
    Serial.printf("[motor] reached %.0f%% (%.1f/%.1fg) — settling %ums\n",
                  FEED_STOP_THRESHOLD * 100.0f, cycle.dispensedG,
                  cycle.targetG, (unsigned)FEED_SETTLE_MS);
    return;
  }

  // Hard safety timeout (30 s)
  if (nowMs - cycle.startMs > STEPPER_MAX_RUN_MS) {
    ledcWrite(STEPPER_STEP, MOTOR_DUTY_STOP);
    motorEmergencyStop();
    if (cycle.dispensedG > 0.5f) {
      cycleFinish("partial", cycle.dispensedG);
    } else {
      cycleFinish("error", 0.0f);
      goToError("Motor timeout");
    }
  }
}
